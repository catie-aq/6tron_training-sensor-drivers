## drivers/sensor/Kconfig
```kconfig
# Copyright (c) 2025 CATIE
# SPDX-License-Identifier: Apache-2.0

if SENSOR

rsource "catie/Kconfig"

endif # SENSOR
```

## drivers/sensor/catie/dummy/Kconfig
```kconfig
# Copyright (c) 2025 CATIE
# SPDX-License-Identifier: Apache-2.0

menuconfig DUMMY
    bool "CATIE dummy TYPE sensor"
    default y
    depends on DT_HAS_CATIE_DUMMY_ENABLED
    help
      Enable driver for CATIE dummy TYPE sensor.
```

## drivers/sensor/catie/mysensor/Kconfig
```kconfig
# Copyright (c) 2025 CATIE
# SPDX-License-Identifier: Apache-2.0

menuconfig MYSENSOR
    bool "CATIE mysensor TYPE sensor"
    default y
    depends on DT_HAS_CATIE_MYSENSOR_ENABLED
    help
      Enable driver for CATIE mysensor TYPE sensor.
```

## dts/bindings/sensor/catie,dummy.yaml
```yaml
# Copyright (c) 2025 CATIE
# SPDX-License-Identifier: Apache-2.0

description: |
    CATIE dummy sensor

compatible: "catie,dummy"

include: [sensor-device.yaml]
```

## dts/bindings/sensor/catie,mysensor.yaml
```yaml
# Copyright (c) 2025 CATIE
# SPDX-License-Identifier: Apache-2.0

description: |
    CATIE mysensor TYPE sensor

compatible: "catie,mysensor"

include: [sensor-device.yaml]
```
